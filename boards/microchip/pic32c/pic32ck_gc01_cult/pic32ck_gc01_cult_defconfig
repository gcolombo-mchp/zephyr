## boards/microchip/pic32c/pic32ck_gc01_cult/pic32ck_gc01_cult_defconfig
```kconfig
# Copyright (c) 2026 Microchip Technology Inc.
# SPDX-License-Identifier: Apache-2.0

CONFIG_BUILD_OUTPUT_HEX=y
CONFIG_ARM_MPU=y
CONFIG_USE_DT_CODE_PARTITION=y

CONFIG_CLOCK_CONTROL=y

CONFIG_SERIAL=y
CONFIG_UART_INTERRUPT_DRIVEN=y
CONFIG_CONSOLE=y
CONFIG_UART_CONSOLE=y
CONFIG_PINCTRL=y
```

## boards/microchip/pic32m/pic32mz_ef_sk/Kconfig.pic32mz_ef_sk
```kconfig
# Copyright (c) 2026 Microchip Technology Inc.
# SPDX-License-Identifier: Apache-2.0

config BOARD_PIC32MZ_EF_SK
	select SOC_PIC32MZ2048EFH144
```

## boards/microchip/pic32m/pic32mz_ef_sk/board.yml
```yaml
# Copyright (c) 2026 Microchip Technology Inc.
# SPDX-License-Identifier: Apache-2.0

board:
  name: pic32mz_ef_sk
  full_name: PIC32MZ Embedded Connectivity with FPU (EF) Starter Kit
  vendor: microchip
  socs:
    - name: pic32mz2048efh144
```

## boards/microchip/pic32m/pic32mz_ef_sk/pic32mz_ef_sk_defconfig
```kconfig
# Copyright (c) 2026 Microchip Technology Inc.
# SPDX-License-Identifier: Apache-2.0

# Execute from flash (XIP), data copied to RAM at startup
CONFIG_XIP=y

# Output format for MPLAB IPE
CONFIG_BUILD_OUTPUT_HEX=y

# Console
CONFIG_CONSOLE=y
CONFIG_SERIAL=y
CONFIG_UART_CONSOLE=y

# --------------------------------------------------------------------------
# PIC32MZ EF Starter Kit (DM320007) Configuration Bits
#
# Hardware: 24 MHz EC oscillator on OSC1/OSC2
# Target: SYSCLK = 200 MHz via System PLL
#   PLL input:  POSC 24 MHz / 3 = 8 MHz (in range 5-10 MHz)
#   VCO:        8 MHz × 50 = 400 MHz (in range 350-700 MHz)
#   SYSCLK:     400 MHz / 2 = 200 MHz
# --------------------------------------------------------------------------

# Use exact DEVCFG values from working Harmony GPIO project
# DEVCFG1: 0x5F74FF39 - FNOSC=SPLL, POSCMOD=EC, WDT off, DMT off
CONFIG_PIC32MZ_DEVCFG1=0x5F74FF39

# DEVCFG2: 0xFFF9B198 - PLL: POSC/3 * 50 / 2 = 200MHz
CONFIG_PIC32MZ_DEVCFG2=0xFFF9B198

# DEVCFG3: 0xFFFFFFFF
CONFIG_PIC32MZ_DEVCFG3=0xFFFFFFFF

# DEVCFG0: 0xFFFFF7D7 - BOOTISA=MIPS32(1), JTAG off
# Based on Harmony 0xFFFFF7D3 but with bit2 set for MIPS32 boot
CONFIG_PIC32MZ_DEVCFG0=0xFFFFF7D7
```

## cmake/toolchain/xc32/Kconfig
```kconfig
# Copyright (c) 2026 Microchip Technology Inc.
# SPDX-License-Identifier: Apache-2.0

config TOOLCHAIN_XC32
	bool
	default y
	select FULL_LIBC_SUPPORTED

config XC32_PROCESSOR
	string "XC32 device processor name"
	default "32MZ2048EFH144"
	help
	  Device name passed to xc32-gcc via -mprocessor= flag.
	  This is the part number without the "PIC" prefix.
```

## cmake/toolchain/xc32/Kconfig.defconfig
```kconfig
# Copyright (c) 2026 Microchip Technology Inc.
# SPDX-License-Identifier: Apache-2.0

if TOOLCHAIN_XC32

config PICOLIBC_SUPPORTED
	default n

config NEWLIB_LIBC_SUPPORTED
	default n

config FULL_LIBC_SUPPORTED
	default y

# XC32 crt0 handles all startup (cache init, .data copy, BSS clear)
config SKIP_BSS_CLEAR
	default y

endif # TOOLCHAIN_XC32
```

## drivers/ethernet/Kconfig.pic32ck_gc_gmac
```kconfig
# Microchip PIC32CK GC Ethernet (GMAC) driver configuration options

# Copyright (c) 2026 Microchip Technology Inc.
# SPDX-License-Identifier: Apache-2.0

menuconfig ETH_PIC32CK_GC_GMAC
	bool "Microchip PIC32CK GC Ethernet driver"
	default y
	depends on NET_BUF_FIXED_DATA_SIZE
	depends on DT_HAS_MICROCHIP_PIC32CK_ETH_ENABLED
	select NOCACHE_MEMORY if ARCH_HAS_NOCACHE_MEMORY_SUPPORT
	select PINCTRL
	help
	  Enable Microchip PIC32CK GC Ethernet (GMAC) driver.

if ETH_PIC32CK_GC_GMAC

config ETH_PIC32CK_GC_GMAC_BUF_RX_COUNT
	int "Network RX buffers preallocated by the ETH driver"
	default 12
	help
	  Number of network buffers that will be permanently allocated by the
	  Ethernet driver. These buffers are used in receive path.

config ETH_PIC32CK_GC_GMAC_QUEUES
	int "Number of priority queues"
	default 1
	range 1 1
	help
	  Number of hardware priority queues (PIC32CK GC supports 1).

endif # ETH_PIC32CK_GC_GMAC
```

## drivers/ethernet/mdio/Kconfig.pic32ck_gc
```kconfig
# Copyright (c) 2026 Microchip Technology Inc.
# SPDX-License-Identifier: Apache-2.0

config MDIO_PIC32CK_GC
	bool "Microchip PIC32CK GC MDIO driver"
	depends on ETH_PIC32CK_GC_GMAC
	default y
	help
	  Enable Microchip PIC32CK GC MDIO driver.
```

## drivers/gpio/Kconfig.mchp
```kconfig
# Copyright (c) 2025 Microchip Technology Inc.
# SPDX-License-Identifier: Apache-2.0

config GPIO_MCHP_PORT_G1
	bool "Microchip PORT G1 GPIO driver"
	default y
	depends on DT_HAS_MICROCHIP_PORT_G1_GPIO_ENABLED
	help
	  This option enables GPIO driver for group (g1) of PORT peripherals.

config GPIO_PIC32MZ
	bool "PIC32MZ GPIO driver"
	default y
	depends on DT_HAS_MICROCHIP_PIC32MZ_GPIO_ENABLED
	help
	  Enable GPIO driver for PIC32MZ MIPS devices.
```

## drivers/interrupt_controller/Kconfig.mchp
```kconfig
# Copyright (c) 2025-2026 Microchip Technology Inc.
# SPDX-License-Identifier: Apache-2.0

config INTC_MCHP_AIC_G1
	bool "Microchip AIC G1 interrupt-controller driver"
	default y
	depends on DT_HAS_MICROCHIP_AIC_G1_INTC_ENABLED
	help
	  This option enables interrupt-controller driver for group (g1) of
	  AIC (Advanced Interrupt Controller) peripherals.

config INTC_MCHP_EIC_G1
	bool "External Interrupt Controller (EIC) Driver for Microchip devices"
	default y
	depends on DT_HAS_MICROCHIP_EIC_G1_INTC_ENABLED
	help
	  Enable EIC driver for Microchip EIC G1 peripherals. This is required for
	  GPIO interrupt support.

config INTC_PIC32MZ_EVIC
	bool "PIC32MZ Enhanced Vectored Interrupt Controller (EVIC) driver"
	default y
	depends on DT_HAS_MICROCHIP_PIC32MZ_EVIC_ENABLED
	help
	  Enable the EVIC interrupt controller driver for PIC32MZ MIPS devices.
	  The EVIC provides 213 individually configurable interrupt vectors with
	  7 priority levels and 4 sub-priority levels. This driver provides
	  arch_irq_enable/disable/is_enabled and ISR dispatch for PIC32MZ.
```

## drivers/pinctrl/Kconfig.mchp
```kconfig
# Copyright (c) 2025 Microchip Technology Inc.
# SPDX-License-Identifier: Apache-2.0

config PINCTRL_MCHP_COMMON
	bool "Microchip pin controller"
	help
	  Common options for Microchip pinctrl drivers.

config PINCTRL_MCHP_PORT_G1
	bool
	default y
	depends on DT_HAS_MICROCHIP_PORT_G1_PINCTRL_ENABLED
	select PINCTRL_MCHP_COMMON
	help
	  This option enables PINCTRL driver for group (g1) of PORT peripherals.

config PINCTRL_PIC32MZ_PPS
	bool "PIC32MZ Peripheral Pin Select (PPS) pin controller"
	default y
	depends on DT_HAS_MICROCHIP_PIC32MZ_PINCTRL_ENABLED
	help
	  Enable the PPS pin controller for PIC32MZ MIPS devices.
	  Configures peripheral-to-pin routing via PPS input and output
	  selection registers, protected by SYSKEY and CFGCON.IOLOCK.

if PINCTRL_MCHP_COMMON

config PIN_OPEN_DRAIN
	bool "Support for open-drain option"
	help
	  This option enables Open drain configuration for the pin.

config PIN_SLEW_RATE
	bool "Support for slew-rate control"
	help
	  This option enables Slew rate for the pin.

config PIN_DRIVE_STRENGTH
	bool "Support for drive strength"
	help
	  This option enables Drive strength for the pin.

endif # PINCTRL_MCHP_COMMON
```

## drivers/usb/udc/Kconfig.pic32ck_fs
```kconfig
# Copyright (c) 2026 Microchip Technology Inc.
# SPDX-License-Identifier: Apache-2.0

config UDC_PIC32CK_FS
	bool "Microchip PIC32CK Full-Speed USB device controller driver"
	default y
	depends on DT_HAS_MICROCHIP_PIC32CK_USB_FS_ENABLED
	select CLOCK_CONTROL
	select EVENTS
	help
	  USB device controller driver for Microchip PIC32CK Full-Speed USB.

if UDC_PIC32CK_FS

config UDC_PIC32CK_FS_STACK_SIZE
	int "PIC32CK FS USB controller driver internal thread stack size"
	default 1024
	help
	  PIC32CK FS USB controller driver internal thread stack size.

config UDC_PIC32CK_FS_THREAD_PRIORITY
	int "PIC32CK FS USB controller driver internal thread priority"
	default 8
	help
	  PIC32CK FS USB controller driver internal thread priority.
	  A cooperative priority is recommended.

endif # UDC_PIC32CK_FS
```

## dts/bindings/clock/microchip/pic32ck_sg_gc/microchip,pic32ck-sg-gc-clock.yaml
```yaml
# Copyright (c) 2026 Microchip Technology Inc.
# SPDX-License-Identifier: Apache-2.0

title: Microchip PIC32CK SG/GC SOC family clock

description: |
  Microchip PIC32CK SG/GC SOC family clock (MCLK, GCLK)

include:
  - name: base.yaml

compatible: "microchip,pic32ck-sg-gc-clock"

properties:
  reg:
    required: true

  "#clock-cells":
    const: 1
    type: int
    description: |
      The subsystem cell is to identify a clock controller sub-system.

  on-timeout-ms:
    type: int
    default: 65
    description: |
      Timeout in milliseconds for clock to be on.
```

## dts/bindings/clock/microchip/pic32ck_sg_gc/microchip,pic32ck-sg-gc-gclkperiph.yaml
```yaml
# Copyright (c) 2026 Microchip Technology Inc.
# SPDX-License-Identifier: Apache-2.0

title: PIC32CK SG/GC Generic clock peripheral

description: |
  Peripheral channel gclk clock configuration. The outputs from the Generators are used as sources
  for the Peripheral Channels, which provide the Generic Clock (GCLK_PERIPH) to the peripheral
  modules.

include: [base.yaml]

compatible: "microchip,pic32ck-sg-gc-gclkperiph"

properties:
  "#clock-cells":
    const: 1
    type: int
    description: |
      The subsystem cell is to identify a clock controller sub-system.

clock-cells:
  - subsystem
```

## dts/bindings/clock/microchip/pic32ck_sg_gc/microchip,pic32ck-sg-gc-mclkperiph.yaml
```yaml
# Copyright (c) 2026 Microchip Technology Inc.
# SPDX-License-Identifier: Apache-2.0

title: PIC32CK SG/GC MCLK (Main Clock) peripheral

description: |
  Main Clock Controller provides synchronous system clocks to the modules
  connected to the AHBx and the APBx buses.

include: [base.yaml]

compatible: "microchip,pic32ck-sg-gc-mclkperiph"

properties:
  "#clock-cells":
    const: 1
    type: int
    description: |
      The subsystem cell is to identify a clock controller sub-system.

clock-cells:
  - subsystem
```

## dts/bindings/clock/microchip/pic32mz_ef/microchip,pic32mz-clock.yaml
```yaml
# Copyright (c) 2026 Microchip Technology Inc.
# SPDX-License-Identifier: Apache-2.0

title: Microchip PIC32MZ Clock Controller

description: |
  PIC32MZ clock controller container node.
  Provides access to the oscillator control (OSCCON), system PLL (SPLLCON),
  and peripheral bus clock dividers (PB1DIV-PB8DIV).

  This is the top-level clock node that contains child nodes for each
  clock source (FRC, POSC, SPLL), the PBCLK distribution, and an optional
  OPP table for runtime clock switching.

  Driver behavior:
    - At init (PRE_KERNEL_1): reads OSCCON and SPLLCON to determine current
      SYSCLK source and frequency. Reads PBxDIV for each peripheral bus.
      Does NOT reprogram PLL (that is done by DEVCFG at reset).
    - At runtime: supports switching between operating points defined in
      the opp-table child node via clock_control_configure().
    - Exposes clock_control_get_rate() for peripheral drivers to query
      their bus clock frequency.

  Reference: DS60001320H Section 8.0 "Oscillator Configuration"

compatible: "microchip,pic32mz-clock"

include:
  - name: base.yaml

properties:
  reg:
    required: true
    description: |
      Register regions:
        [0] - Oscillator and PLL registers (OSCCON, SPLLCON, OSCTUN, etc.)
        [1] - Peripheral Bus Clock divider registers (PB1DIV-PB8DIV)

  reg-names:
    required: true
    description: |
      Names for register regions: "osc", "pb"

  "#clock-cells":
    const: 0
    type: int
    description: |
      This node has no clock cells itself. Peripherals reference the
      pbclk child node which has #clock-cells = <1>.
```

## dts/bindings/clock/microchip/pic32mz_ef/microchip,pic32mz-frc.yaml
```yaml
# Copyright (c) 2026 Microchip Technology Inc.
# SPDX-License-Identifier: Apache-2.0

title: Microchip PIC32MZ Fast RC Oscillator (FRC)

description: |
  Internal Fast RC Oscillator (FRC), nominally 8 MHz.
  Can be used directly as SYSCLK source or as input to the System PLL.
  Supports a tuning range via the OSCTUN register.

  Reference: DS60001320H Section 8.0 "Oscillator Configuration"

compatible: "microchip,pic32mz-frc"

include: [base.yaml]

properties:
  clock-frequency:
    type: int
    default: 8000000
    description: |
      Nominal FRC frequency in Hz. Default is 8 MHz.

  frc-tuning:
    type: int
    default: 0
    description: |
      FRC tuning value written to OSCTUN register.
      Range: -32 to +31 (signed 6-bit), each step ~0.375%.
      0 = factory calibrated center frequency.
```

## dts/bindings/clock/microchip/pic32mz_ef/microchip,pic32mz-opp-table.yaml
```yaml
# Copyright (c) 2026 Microchip Technology Inc.
# SPDX-License-Identifier: Apache-2.0

title: Microchip PIC32MZ Operating Performance Points Table

description: |
  Operating Performance Points (OPP) for PIC32MZ runtime clock switching.

  Each child node defines a named operating point that the clock driver can
  switch to at runtime. This enables power management by selecting lower
  clock speeds when full performance is not needed, and restoring full speed
  when required.

  The clock driver switches the SYSCLK source via the OSCCON register
  (requires SYSKEY unlock sequence) and adjusts PBCLK dividers to maintain
  valid peripheral timing.

  Switching constraints:
    - SPLL requires lock time (~2-5 µs) when switching FROM another source
    - FRC is always available immediately (no lock time)
    - PBCLK dividers can be changed without SYSKEY
    - Peripherals using a PBCLK should be idle during divider change

  Reference: DS60001320H Section 8.0 "Oscillator Configuration"

compatible: "microchip,pic32mz-opp-table"

child-binding:
  description: |
    A single operating performance point.

  properties:
    opp-hz:
      type: int
      required: true
      description: |
        Target SYSCLK frequency in Hz for this operating point.

    clock-source:
      type: string
      required: true
      enum:
        - "frc"
        - "frc-div"
        - "spll"
        - "posc"
        - "sosc"
        - "lprc"
      description: |
        SYSCLK source to select (written to OSCCON.NOSC):
          "frc"     - Fast RC oscillator (8 MHz)
          "frc-div" - FRC with postscaler (FRCDIV)
          "spll"    - System PLL output
          "posc"    - Primary oscillator (crystal/external clock)
          "sosc"    - Secondary oscillator (32.768 kHz)
          "lprc"    - Low-Power RC oscillator (32 kHz)

    pbclk1-div:
      type: int
      default: 1
      description: PBCLK1 divider for this OPP (1-128, power of 2).

    pbclk2-div:
      type: int
      default: 2
      description: PBCLK2 divider (UART, SPI, I2C).

    pbclk3-div:
      type: int
      default: 2
      description: PBCLK3 divider (Timers, IC, OC).

    pbclk4-div:
      type: int
      default: 1
      description: PBCLK4 divider (GPIO ports).

    pbclk5-div:
      type: int
      default: 2
      description: PBCLK5 divider (Flash, Crypto, USB, CAN, Ethernet).

    pbclk7-div:
      type: int
      default: 1
      description: PBCLK7 divider (CPU, Deadman Timer).

    pbclk8-div:
      type: int
      default: 2
      description: PBCLK8 divider (EBI).
```
