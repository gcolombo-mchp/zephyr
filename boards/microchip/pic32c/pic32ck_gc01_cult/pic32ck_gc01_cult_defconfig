## dts/bindings/clock/microchip/pic32mz_ef/microchip,pic32mz-pbclk.yaml
```yaml
# Copyright (c) 2026 Microchip Technology Inc.
# SPDX-License-Identifier: Apache-2.0

title: Microchip PIC32MZ Peripheral Bus Clock Dividers

description: |
  Peripheral Bus Clock (PBCLK) distribution for PIC32MZ devices.
  SYSCLK is divided independently for each of 8 peripheral buses (PBCLK1-PBCLK8).

  Each peripheral is assigned to a specific bus:
    PBCLK1 - Reserved (always = SYSCLK when enabled)
    PBCLK2 - UART, SPI, I2C, Comparator, ADC control
    PBCLK3 - Timer, IC, OC
    PBCLK4 - GPIO (Ports)
    PBCLK5 - Flash Controller, Crypto, RNG, USB, CAN, Ethernet
    PBCLK7 - CPU, Deadman Timer
    PBCLK8 - EBI

  Peripherals reference this node with:
    clocks = <&pbclk N>;
  where N is the PBCLK index (1-8).

  Reference: DS60001320H Section 8.0 "Oscillator Configuration"

compatible: "microchip,pic32mz-pbclk"

include: [base.yaml]

properties:
  clocks:
    required: true
    description: |
      Parent clock source, typically the System PLL (&spll).

  "#clock-cells":
    const: 1
    type: int
    description: |
      Clock specifier cell identifying the peripheral bus index (1-8).

  pbclk1-div:
    type: int
    default: 1
    description: PBCLK1 divider (1 = same as SYSCLK). Usually fixed at 1.

  pbclk2-div:
    type: int
    default: 2
    description: |
      PBCLK2 divider. PBCLK2 = SYSCLK / pbclk2-div.
      Valid values: 1-128 (power of 2 only: 1,2,4,8,16,32,64,128).

  pbclk3-div:
    type: int
    default: 2
    description: PBCLK3 divider.

  pbclk4-div:
    type: int
    default: 1
    description: PBCLK4 divider (GPIO).

  pbclk5-div:
    type: int
    default: 2
    description: PBCLK5 divider (Flash, Crypto, USB, CAN, Ethernet).

  pbclk7-div:
    type: int
    default: 1
    description: PBCLK7 divider (CPU clock).

  pbclk8-div:
    type: int
    default: 2
    description: PBCLK8 divider (EBI).

clock-cells:
  - bus
```

## dts/bindings/clock/microchip/pic32mz_ef/microchip,pic32mz-posc.yaml
```yaml
# Copyright (c) 2026 Microchip Technology Inc.
# SPDX-License-Identifier: Apache-2.0

title: Microchip PIC32MZ Primary Oscillator (POSC)

description: |
  Primary Oscillator (POSC) using an external crystal or clock source
  connected to OSC1/OSC2 pins. Supports XT and EC modes.
  Commonly used as the PLL input for generating SYSCLK.

  Reference: DS60001320H Section 8.0 "Oscillator Configuration"

compatible: "microchip,pic32mz-posc"

include: [base.yaml]

properties:
  clock-frequency:
    type: int
    required: true
    description: |
      External crystal or clock frequency in Hz.
      Typical values: 12000000 (12 MHz), 24000000 (24 MHz).

      This value is also used by the clock driver to validate USB PLL
      configuration: DEVCFG2.UPLLFSEL must match this frequency
      (UPLLFSEL=1 for 24 MHz, UPLLFSEL=0 for 12 MHz).
      If mismatched, USB clock will be reported as unavailable.

  posc-mode:
    type: string
    enum:
      - "xt"
      - "ec"
    default: "ec"
    description: |
      Primary oscillator operating mode:
        "xt" - Crystal oscillator mode (3-40 MHz crystal between OSC1/OSC2)
        "ec" - External Clock mode (external clock signal on OSC1)
```

## dts/bindings/clock/microchip/pic32mz_ef/microchip,pic32mz-spll.yaml
```yaml
# Copyright (c) 2026 Microchip Technology Inc.
# SPDX-License-Identifier: Apache-2.0

title: Microchip PIC32MZ System PLL

description: |
  System PLL (SPLL) for PIC32MZ devices.
  Generates SYSCLK from FRC or POSC input.

  Output frequency = (Input / pll-input-div) * pll-mult / pll-output-div

  Example: 24 MHz POSC, PLLIDIV=3, PLLMULT=50, PLLODIV=2
    → (24/3) * 50 / 2 = 200 MHz SYSCLK

  Constraints:
    - PLL input (after PLLIDIV): 5-64 MHz (recommended 5-10 MHz)
    - VCO frequency (after PLLMULT): 350-700 MHz
    - Output (after PLLODIV): max 200 MHz (or 252 MHz for -250 speed grade)

  Reference: DS60001320H Section 8.0 "Oscillator Configuration"

compatible: "microchip,pic32mz-spll"

include: [base.yaml]

properties:
  clocks:
    required: true
    description: |
      Parent clock source for the PLL input.
      Must reference either &frc or &posc.

  pll-input-div:
    type: int
    required: true
    enum:
      - 1
      - 2
      - 3
      - 4
      - 5
      - 6
      - 7
      - 8
    description: |
      PLL input divider (PLLIDIV field of SPLLCON).
      Divides the input clock before the PLL multiplier.
      Result should be in range 5-10 MHz for best jitter performance.

  pll-mult:
    type: int
    required: true
    description: |
      PLL feedback multiplier (PLLMULT field of SPLLCON).
      Valid range: 1-128.
      VCO frequency = (input / pll-input-div) * pll-mult.
      VCO must be in range 350-700 MHz.

  pll-output-div:
    type: int
    required: true
    enum:
      - 2
      - 4
      - 8
      - 16
      - 32
    description: |
      PLL output divider (PLLODIV field of SPLLCON).
      Final SYSCLK = VCO / pll-output-div.
      Result must not exceed 200 MHz (or 252 MHz for -250 grade).
```

## dts/bindings/ethernet/microchip,pic32ck-eth.yaml
```yaml
# Copyright (c) 2026 Microchip Technology Inc.
# SPDX-License-Identifier: Apache-2.0

description: Microchip PIC32CK Ethernet MAC (Cadence GEM)

compatible: "microchip,pic32ck-eth"

include: [ethernet-controller.yaml, pinctrl-device.yaml]

properties:
  interrupts:
    required: true

  num-queues:
    type: int
    required: true
    description: Number of hardware queues (1-6)

  ref-clk-source:
    type: string
    default: "internal"
    enum:
      - "internal"
      - "external"
    description: Reference clock source for RMII
```

## dts/bindings/ethernet/microchip,pic32ck-ethernet-controller.yaml
```yaml
# Copyright (c) 2026 Microchip Technology Inc.
# SPDX-License-Identifier: Apache-2.0

description: Microchip PIC32CK Ethernet Controller wrapper

compatible: "microchip,pic32ck-ethernet-controller"

include: base.yaml

properties:
  reg:
    required: true
```

## dts/bindings/ethernet/microchip,pic32ck-mdio.yaml
```yaml
# Copyright (c) 2026 Microchip Technology Inc.
# SPDX-License-Identifier: Apache-2.0

description: Microchip PIC32CK MDIO controller

compatible: "microchip,pic32ck-mdio"

include: [mdio-controller.yaml, pinctrl-device.yaml]
```

## dts/bindings/gpio/microchip,pic32mz-gpio.yaml
```yaml
# Copyright (c) 2026 Microchip Technology Inc.
# SPDX-License-Identifier: Apache-2.0

title: Microchip PIC32MZ GPIO Port

description: |
  GPIO controller for a single port (A-K) on PIC32MZ devices.

  Each port provides up to 16 pins with the following per-pin capabilities:
    - Digital input/output (TRIS/LAT/PORT registers)
    - Analog/Digital selection (ANSEL register)
    - Open-drain output (ODC register)
    - Internal pull-up/pull-down (CNPU/CNPD registers)
    - Input Change Notification interrupt (CNCON/CNEN/CNSTAT)

  Register layout per port (0x100 bytes with CLR/SET/INV for each):
    +0x00 ANSEL   - Analog Select
    +0x10 TRIS    - Tri-State (direction: 1=input, 0=output)
    +0x20 PORT    - Port Read
    +0x30 LAT     - Latch (output data)
    +0x40 ODC     - Open-Drain Configuration
    +0x50 CNPU    - Change Notification Pull-Up Enable
    +0x60 CNPD    - Change Notification Pull-Down Enable
    +0x70 CNCON   - Change Notification Control
    +0x80 CNEN0   - CN Enable (falling edge)
    +0x90 CNSTAT  - CN Status
    +0xA0 CNEN1   - CN Enable (rising edge)

  Reference: DS60001320H Section 12.0 "I/O Ports"

compatible: "microchip,pic32mz-gpio"

include:
  - name: base.yaml
  - name: gpio-controller.yaml

properties:
  reg:
    required: true
    description: |
      Base address and size of the port register block (0x100 bytes).

  "#gpio-cells":
    const: 2

  interrupt-parent:
    description: Reference to the EVIC interrupt controller.

  clocks:
    description: |
      Reference to PBCLK4 (GPIO bus clock).

  microchip,port-index:
    type: int
    description: |
      Port index (0=A, 1=B, ... 10=K).
      Used by the driver to compute Change Notification interrupt vectors.

gpio-cells:
  - pin
  - flags
```
