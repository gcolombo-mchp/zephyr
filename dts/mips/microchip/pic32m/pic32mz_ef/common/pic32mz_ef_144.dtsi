/*
 * Copyright (c) 2026 Microchip Technology Inc.
 *
 * SPDX-License-Identifier: Apache-2.0
 *
 * Pin-count variant for 144-pin PIC32MZ EF packages.
 * Adds GPIO ports H, J, K (available only on 124/144-pin devices).
 */

#include <microchip/pic32m/pic32mz_ef/common/pic32mz_ef.dtsi>

&pinctrl {
	porth: gpio@bf860700 {
		compatible = "microchip,pic32mz-gpio";
		reg = <0xbf860700 0x100>;
		gpio-controller;
		#gpio-cells = <2>;
		interrupt-parent = <&evic>;
		status = "disabled";
	};

	portj: gpio@bf860800 {
		compatible = "microchip,pic32mz-gpio";
		reg = <0xbf860800 0x100>;
		gpio-controller;
		#gpio-cells = <2>;
		interrupt-parent = <&evic>;
		status = "disabled";
	};

	portk: gpio@bf860900 {
		compatible = "microchip,pic32mz-gpio";
		reg = <0xbf860900 0x100>;
		gpio-controller;
		#gpio-cells = <2>;
		interrupt-parent = <&evic>;
		status = "disabled";
	};
};
