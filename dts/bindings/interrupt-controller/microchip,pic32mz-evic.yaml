## dts/bindings/interrupt-controller/microchip,pic32mz-evic.yaml
```yaml
# Copyright (c) 2026 Microchip Technology Inc.
# SPDX-License-Identifier: Apache-2.0

title: Microchip PIC32MZ Enhanced Vectored Interrupt Controller (EVIC)

description: |
  Enhanced Vectored Interrupt Controller for PIC32MZ devices.

  The EVIC sits between peripheral interrupt sources and the MIPS CPU core
  interrupt controller (mti,cpu-intc). It receives up to 213 independent
  interrupt requests, prioritizes them, and presents a single signal to the
  CPU on one of the 8 hardware interrupt lines (typically HW interrupt 2).

  Key features:
    - Up to 213 interrupt sources, each with a dedicated vector
    - 7 programmable priority levels (1-7, 0 = disabled)
    - 4 sub-priority levels within each priority
    - Variable vector offset per source (OFFxxx registers)
    - Multi-vector and single-vector operation modes
    - 7 shadow register sets assignable to any priority level
    - 5 external interrupt pins with edge polarity control

  Register layout at base address (e.g., 0xBF810000):
    +0x0000  INTCON   - Interrupt Control (MVEC bit enables multi-vector mode)
    +0x0010  PRISS    - Priority Shadow Set assignment
    +0x0020  INTSTAT  - Interrupt Status (active vector/priority)
    +0x0030  IPTMR    - Interrupt Proximity Timer
    +0x0040  IFS0     - Interrupt Flag Status 0 (IRQ 0-31)
    +0x0050  IFS1     - Interrupt Flag Status 1 (IRQ 32-63)
    +0x0060  IFS2     - Interrupt Flag Status 2 (IRQ 64-95)
    +0x0070  IFS3     - Interrupt Flag Status 3 (IRQ 96-127)
    +0x0080  IFS4     - Interrupt Flag Status 4 (IRQ 128-159)
    +0x0090  IFS5     - Interrupt Flag Status 5 (IRQ 160-191)
    +0x00A0  IFS6     - Interrupt Flag Status 6 (IRQ 192-212)
    +0x00C0  IEC0     - Interrupt Enable Control 0
    ...
    +0x0120  IEC6     - Interrupt Enable Control 6
    +0x0140  IPC0     - Interrupt Priority Control 0 (4 IRQs per register)
    ...
    +0x02AC  IPC53    - Interrupt Priority Control 53
    +0x0540  OFF000   - Vector Offset for IRQ 0
    ...
    +0x08B4  OFF212   - Vector Offset for IRQ 212

  Each IFSn/IECn register covers 32 interrupt sources.
  IRQ N is at: IFS[N/32] bit (N%32), IEC[N/32] bit (N%32).

  Each IPC register holds priority for 4 IRQs:
    Bits [4:2]   = priority for IRQ (regidx*4 + 0)
    Bits [1:0]   = sub-priority for IRQ (regidx*4 + 0)
    Bits [12:10] = priority for IRQ (regidx*4 + 1)
    ... and so on in 8-bit groups.

  In Zephyr, the EVIC driver must:
    1. Set INTCON.MVEC = 1 (multi-vector mode)
    2. Program OFFxxx registers to point to the Zephyr ISR dispatch table
    3. Provide irq_enable/irq_disable via IECn SET/CLR registers
    4. Clear interrupt flags via IFSn CLR on ISR entry

  Reference: DS60001320H Section 7.0 "CPU Exceptions and Interrupt Controller"
  Reference: Harmony CSP peripheral/evic_02907

compatible: "microchip,pic32mz-evic"

include: [interrupt-controller.yaml, base.yaml]

properties:
  reg:
    required: true
    description: |
      Base address and size of the EVIC register block.
      Typically <0xbf810000 0x1000>.

  interrupts:
    required: true
    description: |
      The CPU hardware interrupt line that the EVIC drives.
      In a typical PIC32MZ configuration, EVIC output is routed to
      CPU HW interrupt 2 (IP2 in CP0 Cause register).
      Specified as a single cell referencing the parent mti,cpu-intc.

  interrupt-parent:
    required: true
    description: |
      Must reference the CPU interrupt controller (&cpu_intc).

  "#interrupt-cells":
    const: 2
    description: |
      Two cells per interrupt specifier:
        Cell 0: IRQ number (0-212)
        Cell 1: Priority level (1-7, where 7 is highest)

      Sub-priority defaults to 0 and can be set at runtime by the driver.

  microchip,num-irqs:
    type: int
    default: 213
    description: |
      Number of interrupt sources supported.
      PIC32MZ EF family: 213.

  microchip,shadow-sets:
    type: int
    default: 7
    description: |
      Number of shadow register sets available (0 = none, max 7).
      Shadow sets reduce ISR latency by eliminating register save/restore
      for the assigned priority level. Configured via PRISS register.

  microchip,priority-to-shadow:
    type: array
    description: |
      Optional mapping of priority levels to shadow register sets.
      Array of 7 entries (index = priority 1-7), each value = shadow set (0-7, 0 = none).
      Example: <0 0 0 0 1 2 3> assigns shadow sets 1,2,3 to priorities 5,6,7.
      If omitted, shadow sets are not used.

interrupt-cells:
  - irq
  - priority
```

## dts/bindings/pinctrl/microchip,pic32mz-pinctrl.yaml
```yaml
# Copyright (c) 2026 Microchip Technology Inc.
# SPDX-License-Identifier: Apache-2.0

title: Microchip PIC32MZ Peripheral Pin Select (PPS) Pin Controller

description: |
  PIC32MZ Peripheral Pin Select (PPS) pin controller.

  On PIC32MZ devices, most peripheral I/O signals (UART TX/RX, SPI SDI/SDO,
  I2C SDA/SCL, etc.) are not hard-wired to specific pins. Instead, they are
  routed through the PPS multiplexer, allowing flexible pin assignment.

  PPS is configured via two sets of registers:
    - Input registers (e.g., U1RXR, SDI1R): select which pin drives a
      peripheral input
    - Output registers (e.g., RPA0R, RPB0R): select which peripheral function
      drives a pin output

  PPS registers base address: 0xBF801400 (offset from system config base).

  Pin configuration example:

    &pinctrl {
      uart2_default: uart2_default {
        group1 {
          pinmux = <PPS_U2TX_RPG9>, <PPS_U2RX_RPB0>;
        };
      };
    };

  Reference: DS60001320H Section 12.0 "I/O Ports"

compatible: "microchip,pic32mz-pinctrl"

include: base.yaml

properties:
  reg:
    required: true
    description: |
      Register region covering the PPS input and output selection registers.

  "#address-cells":
    const: 1

  "#size-cells":
    const: 1

child-binding:
  description: |
    Each child node defines pin configuration for a particular device state.

  child-binding:
    description: |
      Pin group with shared configuration properties.

    include:
      - name: pincfg-node.yaml
        property-allowlist:
          - bias-pull-up
          - bias-pull-down
          - drive-open-drain
          - input-enable
          - output-enable

    properties:
      pinmux:
        required: true
        type: array
        description: |
          Array of PPS pin mux values. Each entry encodes the peripheral
          function and physical pin assignment using macros defined in
          dt-bindings/pinctrl/pic32mz-pinctrl.h.
```

## dts/bindings/serial/microchip,pic32mz-uart.yaml
```yaml
# Copyright (c) 2026 Microchip Technology Inc.
# SPDX-License-Identifier: Apache-2.0

title: Microchip PIC32MZ UART

description: |
  Universal Asynchronous Receiver Transmitter (UART) for PIC32MZ devices.

  The PIC32MZ UART is a full-duplex serial interface with the following features:
    - 8-level deep TX and RX FIFOs (9-bit wide)
    - Programmable baud rate generator (16-bit BRG)
    - Standard speed (÷16) and high-speed (÷4) modes
    - 8-bit or 9-bit data, odd/even/no parity, 1 or 2 stop bits
    - Hardware flow control (RTS/CTS) via UEN bits
    - IrDA encoder/decoder
    - Loopback mode for diagnostics
    - Auto-baud detection
    - Address character detection (9-bit mode)
    - 3 interrupt sources per instance: Fault, RX, TX

  Register layout per UART instance (5 core registers, each with CLR/SET/INV):
    +0x00  UxMODE   - Mode Control
    +0x10  UxSTA    - Status and Control
    +0x20  UxTXREG  - Transmit Data
    +0x30  UxRXREG  - Receive Data
    +0x40  UxBRG    - Baud Rate Generator

  Baud rate calculation:
    BRGH=0 (standard): Baud = PBCLK2 / (16 * (UxBRG + 1))
    BRGH=1 (high-speed): Baud = PBCLK2 / (4 * (UxBRG + 1))

  Note: Register spacing between UART instances is 0x200.
  UARTs are clocked from Peripheral Bus Clock 2 (PBCLK2).

  Reference: DS60001107H - PIC32 FRM Section 21 "UART"
  Reference: DS60001320H - PIC32MZ EF Data Sheet, Section 22
  Reference: Harmony CSP peripheral/uart_02478

compatible: "microchip,pic32mz-uart"

include:
  - name: base.yaml
  - name: uart-controller.yaml
  - name: pinctrl-device.yaml

properties:
  reg:
    required: true
    description: |
      Base address and size of the UART register block.
      Size should be 0x50 (5 registers × 0x10 spacing including CLR/SET/INV).

  interrupts:
    required: true
    description: |
      Three interrupt specifiers in order:
        1. Fault interrupt (framing, parity, overflow errors)
        2. RX interrupt (receive data available)
        3. TX interrupt (transmit buffer empty)
      Each specifier is <irq_number priority> per the EVIC binding.

  interrupt-names:
    description: |
      Names for the three interrupt sources: "fault", "rx", "tx".

  clocks:
    required: true
    description: |
      Reference to the peripheral bus clock (PBCLK2) that drives the BRG.
      Typically: clocks = <&pbclk 2>;

  current-speed:
    type: int
    default: 115200
    description: |
      Initial baud rate in bits per second.

  microchip,high-speed:
    type: boolean
    description: |
      If present, use high-speed baud rate mode (BRGH=1, ÷4 divisor).
      Default (absent) uses standard mode (BRGH=0, ÷16 divisor).
      High-speed mode provides better accuracy at high baud rates but
      reduces noise immunity (single sample vs. majority detect).

      Note: Silicon errata on some revisions affects BRGH=1 for baud
      rates below 7.5 Mbps. Check device errata before enabling.

  microchip,rx-fifo-threshold:
    type: string
    enum:
      - "not-empty"
      - "half-full"
      - "three-quarter"
    default: "not-empty"
    description: |
      RX interrupt trigger level (URXISEL bits in UxSTA):
        "not-empty"     - Interrupt when at least 1 character in RX FIFO
        "half-full"     - Interrupt when 4+ characters in RX FIFO
        "three-quarter" - Interrupt when 6+ characters in RX FIFO

  microchip,tx-fifo-threshold:
    type: string
    enum:
      - "empty"
      - "half-empty"
      - "not-full"
    default: "not-full"
    description: |
      TX interrupt trigger level (UTXISEL bits in UxSTA):
        "empty"      - Interrupt when TX buffer and shift register are empty
        "half-empty" - Interrupt when TX buffer is at least half empty
        "not-full"   - Interrupt when TX buffer has at least one empty slot

  hw-flow-control:
    type: boolean
    description: |
      If present, enable hardware flow control using UxRTS and UxCTS pins.
      Sets UEN<1:0> = 10 in UxMODE (UxRTS in flow control mode, UxCTS active).
      Pin routing must be configured separately via PPS pinctrl.
```

## dts/bindings/usb/microchip,pic32ck-usb-fs.yaml
```yaml
# Copyright (c) 2026 Microchip Technology Inc.
# SPDX-License-Identifier: Apache-2.0

description: |
    Microchip PIC32CK Full-Speed USB in device mode.

    The PIC32CK USB FS controller has 8 bidirectional endpoints (EP0-EP7).

compatible: "microchip,pic32ck-usb-fs"

include:
  - name: usb-ep.yaml
  - name: pinctrl-device.yaml

properties:
  reg:
    required: true

  interrupts:
    required: true

  num-bidir-endpoints:
    required: true
    type: int
    description: |
      Number of bidirectional endpoints supported by the controller.
```

## samples/net/dhcpv4_client/boards/pic32ck_gc01_cult.conf
```kconfig
CONFIG_LOG=y
CONFIG_LOG_MODE_MINIMAL=y
CONFIG_NET_BUF_FIXED_DATA_SIZE=y
CONFIG_NET_BUF_DATA_SIZE=1536
CONFIG_NET_L2_ETHERNET=y
CONFIG_ETH_PIC32CK_GC_GMAC=y
CONFIG_MAIN_STACK_SIZE=4096
```

## samples/net/sockets/echo_server/boards/pic32ck_gc01_cult.conf
```kconfig
CONFIG_LOG=y
CONFIG_LOG_MODE_MINIMAL=y
CONFIG_NET_BUF_FIXED_DATA_SIZE=y
CONFIG_NET_BUF_DATA_SIZE=1536
CONFIG_NET_L2_ETHERNET=y
CONFIG_ETH_PIC32CK_GC_GMAC=y
CONFIG_MAIN_STACK_SIZE=4096
CONFIG_NET_CONFIG_MY_IPV4_ADDR="192.168.1.200"
CONFIG_NET_CONFIG_MY_IPV4_GW="192.168.1.1"
CONFIG_NET_CONFIG_MY_IPV4_NETMASK="255.255.255.0"
```

## samples/net/zperf/boards/pic32ck_gc01_cult.conf
```kconfig
CONFIG_LOG=y
CONFIG_UART_INTERRUPT_DRIVEN=y
CONFIG_NET_L2_ETHERNET=y
CONFIG_ETH_PIC32CK_GC_GMAC=y
CONFIG_MAIN_STACK_SIZE=4096
CONFIG_NET_CONFIG_SETTINGS=y
CONFIG_NET_CONFIG_MY_IPV4_ADDR="192.168.1.200"
CONFIG_NET_CONFIG_MY_IPV4_GW="192.168.1.1"
CONFIG_NET_CONFIG_MY_IPV4_NETMASK="255.255.255.0"
CONFIG_NET_IPV6=n
CONFIG_NET_SHELL=y
CONFIG_SHELL=y
```

## soc/microchip/pic32m/pic32mz_ef/Kconfig
```kconfig
# Copyright (c) 2026 Microchip Technology Inc.
# SPDX-License-Identifier: Apache-2.0

config SOC_FAMILY_MICROCHIP_PIC32MZ_EF
	select MIPS
	select CLOCK_CONTROL
```
